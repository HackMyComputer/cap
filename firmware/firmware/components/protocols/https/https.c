/* Simple Access Point with HTTP Server Example

   Wi-Fi SoftAP Example + Simple HTTPD Server Example

   This example code is in the Public Domain (or CC0 licensed, at your option.)

   Unless required by applicable law or agreed to in writing, this
   software is distributed on an "AS IS" BASIS, WITHOUT WARRANTIES OR
   CONDITIONS OF ANY KIND, either express or implied.
   */

#include <string.h>
#include <esp_wifi.h>
#include <esp_event.h>
#include <esp_log.h>
#include <esp_system.h>
#include <nvs_flash.h>
#include <sys/param.h>

#include "nvs_flash.h"
#include "esp_netif.h"
#include "esp_eth.h"
#include "esp_mac.h"
#include "esp_tls_crypto.h"
#include "esp_http_server.h"
#include "freertos/FreeRTOS.h"
#include "freertos/task.h"
#include "esp_system.h"
#include "lwip/err.h"
#include "lwip/sys.h"
#include "esp_wifi_types.h"

#include "driver/gpio.h"

/* The examples use WiFi configuration that you can set via project configuration menu.

   If you'd rather not, just change the below entries to strings with
   the config you want - ie #define EXAMPLE_WIFI_SSID "mywifissid"
   */

#define EXAMPLE_ESP_WIFI_SSID      "CAP-Device" 	//CONFIG_ESP_WIFI_SSID
#define EXAMPLE_ESP_WIFI_PASS      "cap_password" 	//CONFIG_ESP_WIFI_PASSWORD
#define EXAMPLE_MAX_STA_CONN        5 			//CONFIG_ESP_MAX_STA_CONN


#ifndef CONFIG_INDEX_HTML 

unsigned char index_html[] = {
    0x3c, 0x21, 0x44, 0x4f, 0x43, 0x54, 0x59, 0x50, 0x45, 0x20, 0x68, 0x74,
    0x6d, 0x6c, 0x3e, 0x0a, 0x3c, 0x68, 0x74, 0x6d, 0x6c, 0x20, 0x6c, 0x61,
    0x6e, 0x67, 0x3d, 0x22, 0x65, 0x6e, 0x22, 0x3e, 0x0a, 0x3c, 0x68, 0x65,
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    0x3c, 0x2f, 0x68, 0x74, 0x6d, 0x6c, 0x3e, 0x20, 0x0a
};

unsigned int index_html_len = 6093;

#endif

/* A simple example that demonstrates how to create GET and POST
 * handlers for the web server.
 */

static const char *TAG = "wifi_AP_WEBserver";

/* An webkit response class to render webpage on the ESP32 Web server */
typedef struct {
    const unsigned char *resp; 
    size_t 		*resp_len; 
} WEBKIT_RESPONSE_ARGS;

WEBKIT_RESPONSE_ARGS webkit_upload_args = { .resp = index_html, .resp_len = &index_html_len };

esp_err_t webkit_request_handler(httpd_req_t *req) 
{
    WEBKIT_RESPONSE_ARGS *args = (WEBKIT_RESPONSE_ARGS*)(req->user_ctx); 

    ESP_ERROR_CHECK(httpd_resp_set_type(req, HTTPD_TYPE_TEXT)); 
    ESP_ERROR_CHECK(httpd_resp_send(req, (const char*) args->resp, *(args->resp_len))); 
    return ESP_OK; 
} 

httpd_uri_t webkit_upload_req = {
    .uri = "/index.html", 
    .method = HTTP_GET, 
    .handler = webkit_request_handler,
    .user_ctx = (void*)&webkit_upload_args,
};

 
esp_err_t webkit_home_handler(httpd_req_t *req) 
{
    return 0;
}

httpd_uri_t webkit_home_req =  {
    .uri = "/home", 
    .method = HTTP_GET, 
    .handler = &webkit_home_handler, 
    .user_ctx = NULL,
};

/* An HTTP GET handler */
static esp_err_t probe_get_handler(httpd_req_t *req)
{
    char*  buf;
    size_t buf_len;

    /* Get header value string length and allocate memory for length + 1,
     * extra byte for null termination */
    buf_len = httpd_req_get_hdr_value_len(req, "Host") + 1;
    if (buf_len > 1) {
	buf = malloc(buf_len);
	/* Copy null terminated value string into buffer */
	if (httpd_req_get_hdr_value_str(req, "Host", buf, buf_len) == ESP_OK) {
	    ESP_LOGI(TAG, "Found header => Host: %s", buf);
	}
	free(buf);
    }

    buf_len = httpd_req_get_hdr_value_len(req, "Test-Header-2") + 1;
    if (buf_len > 1) {
	buf = malloc(buf_len);
	if (httpd_req_get_hdr_value_str(req, "Test-Header-2", buf, buf_len) == ESP_OK) {
	    ESP_LOGI(TAG, "Found header => Test-Header-2: %s", buf);
	}
	free(buf);
    }

    buf_len = httpd_req_get_hdr_value_len(req, "Test-Header-1") + 1;
    if (buf_len > 1) {
	buf = malloc(buf_len);
	if (httpd_req_get_hdr_value_str(req, "Test-Header-1", buf, buf_len) == ESP_OK) {
	    ESP_LOGI(TAG, "Found header => Test-Header-1: %s", buf);
	}
	free(buf);
    }

    /* Read URL query string length and allocate memory for length + 1,
     * extra byte for null termination */
    buf_len = httpd_req_get_url_query_len(req) + 1;
    if (buf_len > 1) {
	buf = malloc(buf_len);
	if (httpd_req_get_url_query_str(req, buf, buf_len) == ESP_OK) {
	    ESP_LOGI(TAG, "Found URL query => %s", buf);
	    char param[32];
	    /* Get value of expected key from query string */
	    if (httpd_query_key_value(buf, "query1", param, sizeof(param)) == ESP_OK) {
		ESP_LOGI(TAG, "Found URL query parameter => query1=%s", param);
	    }
	    if (httpd_query_key_value(buf, "query3", param, sizeof(param)) == ESP_OK) {
		ESP_LOGI(TAG, "Found URL query parameter => query3=%s", param);
	    }
	    if (httpd_query_key_value(buf, "query2", param, sizeof(param)) == ESP_OK) {
		ESP_LOGI(TAG, "Found URL query parameter => query2=%s", param);
	    }
	}
	free(buf);
    }

    /* Set some custom headers */
    httpd_resp_set_hdr(req, "Custom-Header-1", "Custom-Value-1");
    httpd_resp_set_hdr(req, "Custom-Header-2", "Custom-Value-2");

    /* Send response with custom headers and body set as the
     * string passed in user context*/
    const char* resp_str = (const char*) req->user_ctx;
    httpd_resp_send(req, resp_str, HTTPD_RESP_USE_STRLEN);

    /* After sending the HTTP response the old HTTP request
     * headers are lost. Check if HTTP request headers can be read now. */
    if (httpd_req_get_hdr_value_len(req, "Host") == 0) {
	ESP_LOGI(TAG, "Request headers lost");
    }
    return ESP_OK;
}

static const httpd_uri_t probe = {
    .uri       = "/probe",
    .method    = HTTP_GET,
    .handler   = probe_get_handler,
    /* Let's pass response string in user
     * context to demonstrate it's usage */
    .user_ctx  = "Device already registered"
};

/* Controls the state of the led */
int led_state = 0; 

/* Simple handler to blink GPIO 2 led */
esp_err_t on_handler(httpd_req_t *req)
{
    gpio_set_level(GPIO_NUM_2, 1);
    led_state = 1;
    const char resp[] = "<h3>LED State: ON</h3><a href=\"/on\"><button>Turn ON</button></a><a href=\"/off\"><button>Turn OFF</button</a>";
    httpd_resp_send(req, resp, HTTPD_RESP_USE_STRLEN);
    return ESP_OK;
}

static httpd_uri_t uri_on = {
    .uri = "/on",
    .method = HTTP_GET, 
    .handler = on_handler, 
    .user_ctx = NULL
};

/* Simple handler to blink GPIO 2 led */
esp_err_t off_handler(httpd_req_t *req)
{
    gpio_set_level(GPIO_NUM_2, 0);
    led_state = 0;
    const char resp[] = "<h3>LED State: OFF</h3><a href=\"/on\"><button>Turn ON</button></a><a href=\"/off\"><button>Turn OFF</button</a>";
    httpd_resp_send(req, resp, HTTPD_RESP_USE_STRLEN);
    return ESP_OK;
}

static httpd_uri_t uri_off = {
    .uri = "/off",
    .method = HTTP_GET, 
    .handler = off_handler, 
    .user_ctx = NULL
};

/* This handler allows the custom error handling functionality to be
 * tested from client side. For that, when a PUT request 0 is sent to
 * URI /ctrl, the /probe and /echo URIs are unregistered and following
 * custom error handler http_404_error_handler() is registered.
 * Afterwards, when /probe or /echo is requested, this custom error
 * handler is invoked which, after sending an error message to client,
 * either closes the underlying socket (when requested URI is /echo)
 * or keeps it open (when requested URI is /probe). This allows the
 * client to infer if the custom error handler is functioning as expected
 * by observing the socket state.
 */
esp_err_t http_404_error_handler(httpd_req_t *req, httpd_err_code_t err)
{
    /* For any other URI defined above send 404 and close socket */
    httpd_resp_send_err(req, HTTPD_404_NOT_FOUND, "404 not found");
    return ESP_FAIL;
}

static httpd_handle_t start_webserver(void)
{
    httpd_handle_t server = NULL;
    httpd_config_t config = HTTPD_DEFAULT_CONFIG();
    config.lru_purge_enable = true;

    // Start the httpd server
    ESP_LOGI(TAG, "Starting server on port: '%d'", config.server_port);
    if (httpd_start(&server, &config) == ESP_OK) {
	// Set URI handlers
	ESP_LOGI(TAG, "Registering URI handlers");
	httpd_register_uri_handler(server, &probe);
	httpd_register_uri_handler(server, &webkit_upload_req);
	httpd_register_uri_handler(server, &uri_on); 
	httpd_register_uri_handler(server, &uri_off); 
#if CONFIG_EXAMPLE_BASIC_AUTH
	httpd_register_basic_auth(server);
#endif
	return server;
    }

    ESP_LOGI(TAG, "Error starting server!");
    return NULL;
}

static esp_err_t stop_webserver(httpd_handle_t server)
{
    // Stop the httpd server
    return httpd_stop(server);
}


static void disconnect_handler(void* arg, esp_event_base_t event_base,
	int32_t event_id, void* event_data)
{
    httpd_handle_t *server = (httpd_handle_t*) arg;
    if (*server) {
	ESP_LOGI(TAG, "Stopping webserver");
	if (stop_webserver(*server) == ESP_OK) {
	    *server = NULL;
	} else {
	    ESP_LOGE(TAG, "Failed to stop http server");
	}
    }
}


static void connect_handler(void* arg, esp_event_base_t event_base,
	int32_t event_id, void* event_data)
{
    httpd_handle_t *server = (httpd_handle_t*) arg;
    if (*server == NULL) {
	ESP_LOGI(TAG, "Starting webserver");
	*server = start_webserver();
    }
}


static void wifi_event_handler(void* arg, esp_event_base_t event_base, int32_t event_id, void* event_data)
{
    if (event_id == WIFI_EVENT_AP_STACONNECTED) {
	wifi_event_ap_staconnected_t* event = (wifi_event_ap_staconnected_t*) event_data;
	ESP_LOGI(TAG, "station "MACSTR" join, AID=%d",
		MAC2STR(event->mac), event->aid);
    } else if (event_id == WIFI_EVENT_AP_STADISCONNECTED) {
	wifi_event_ap_stadisconnected_t* event = (wifi_event_ap_stadisconnected_t*) event_data;
	ESP_LOGI(TAG, "station "MACSTR" leave, AID=%d",
		MAC2STR(event->mac), event->aid);
    }
}


esp_err_t wifi_init_softap(void)
{
    esp_netif_create_default_wifi_ap();

    wifi_init_config_t cfg = WIFI_INIT_CONFIG_DEFAULT();
    ESP_ERROR_CHECK(esp_wifi_init(&cfg));

    ESP_ERROR_CHECK(esp_event_handler_register(WIFI_EVENT, ESP_EVENT_ANY_ID, &wifi_event_handler, NULL));

    wifi_config_t wifi_config = {
	.ap = {
	    .ssid = EXAMPLE_ESP_WIFI_SSID,
	    .ssid_len = strlen(EXAMPLE_ESP_WIFI_SSID),
	    .password = EXAMPLE_ESP_WIFI_PASS,
	    .max_connection = EXAMPLE_MAX_STA_CONN,
	    .authmode = WIFI_AUTH_WPA_WPA2_PSK
	},
    };
    if (strlen(EXAMPLE_ESP_WIFI_PASS) == 0) {
	wifi_config.ap.authmode = WIFI_AUTH_OPEN;
    }

    ESP_ERROR_CHECK(esp_wifi_set_mode(WIFI_MODE_AP));
    ESP_ERROR_CHECK(esp_wifi_set_config(ESP_IF_WIFI_AP, &wifi_config));
    ESP_ERROR_CHECK(esp_wifi_start());

    ESP_LOGI(TAG, "wifi_init_softap finished. SSID:%s password:%s",
	    EXAMPLE_ESP_WIFI_SSID, EXAMPLE_ESP_WIFI_PASS);
    return ESP_OK;
}


void httpd(void)
{
    static httpd_handle_t server = NULL;

    gpio_reset_pin(GPIO_NUM_2); 
    gpio_set_direction(GPIO_NUM_2, GPIO_MODE_OUTPUT); 

    ESP_LOGI(TAG, "NVS init");
    ESP_ERROR_CHECK(nvs_flash_init());
    ESP_ERROR_CHECK(esp_netif_init());

    ESP_LOGI(TAG, "Eventloop create");
    ESP_ERROR_CHECK(esp_event_loop_create_default());

    /* This helper function configures Wi-Fi or Ethernet, as selected in menuconfig.
     * Read "Establishing Wi-Fi or Ethernet Connection" section in
     * examples/protocols/README.md for more information about this function.
     */

    ESP_LOGI(TAG, "init softAP");
    ESP_ERROR_CHECK(wifi_init_softap());

    /* Register event handlers to stop the server when Wi-Fi or Ethernet is disconnected,
     * and re-start it upon connection.
     */
#ifdef CONFIG_EXAMPLE_CONNECT_WIFI
    ESP_ERROR_CHECK(esp_event_handler_register(IP_EVENT, IP_EVENT_STA_GOT_IP, &connect_handler, &server));
    ESP_ERROR_CHECK(esp_event_handler_register(WIFI_EVENT, WIFI_EVENT_STA_DISCONNECTED, &disconnect_handler, &server));
#endif // CONFIG_EXAMPLE_CONNECT_WIFI
#ifdef CONFIG_EXAMPLE_CONNECT_ETHERNET
    ESP_ERROR_CHECK(esp_event_handler_register(IP_EVENT, IP_EVENT_ETH_GOT_IP, &connect_handler, &server));
    ESP_ERROR_CHECK(esp_event_handler_register(ETH_EVENT, ETHERNET_EVENT_DISCONNECTED, &disconnect_handler, &server));
#endif // CONFIG_EXAMPLE_CONNECT_ETHERNET

    /* Start the server for the first time */
    server = start_webserver();
}
